## sdkconfig.defaults
```kconfig
# Default configuration for ESP32
# Add your custom configuration parameters here
CONFIG_BT_ENABLED=y
CONFIG_BT_BLUEDROID_ENABLED=y
CONFIG_BT_CLASSIC_ENABLED=y
CONFIG_BT_SCO_ENABLED=y
CONFIG_BT_HFP_AG_ENABLE=y

# Подробное логирование для диагностики
CONFIG_LOG_DEFAULT_LEVEL=5
CONFIG_LOG_MAXIMUM_LEVEL=5

# Bluetooth Controller настройки - исправлено для Classic BT
CONFIG_BTDM_CTRL_MODE_BT_ONLY=y
CONFIG_BTDM_CTRL_MODE_BR_EDR_ONLY=y
CONFIG_BTDM_CTRL_BR_EDR_SCO_DATA_PATH_EFF=0
CONFIG_BTDM_CTRL_AUTO_LATENCY=y
CONFIG_BTDM_CTRL_AUTO_LATENCY_EFF=1
CONFIG_BTDM_CTRL_PINNED_TO_CORE_0=y
CONFIG_BTDM_CTRL_PINNED_TO_CORE=0

# RFCOMM настройки для стабильности соединения
CONFIG_BT_RFCOMM_ENABLE=y
CONFIG_BT_SPP_ENABLE=n
CONFIG_BT_HFP_ROLE_AG=y
CONFIG_BT_HFP_AUDIO_DATA_PATH_PCM=y

# HFP AG настройки - исправлено
CONFIG_BT_HFP_WBS_ENABLE=y
CONFIG_BT_HFP_CVSD_ENABLE=y
CONFIG_BT_HFP_MSBC_ENABLE=y

# Отключение BLE для экономии памяти  
CONFIG_BT_BLE_ENABLED=n
CONFIG_BT_GATTS_ENABLE=n
CONFIG_BT_GATTC_ENABLE=n

# Отключение ненужных профилей
CONFIG_BT_A2DP_ENABLE=n
CONFIG_BT_AVRC_ENABLE=n

# SDP и Service Discovery настройки
CONFIG_BT_SDP_ENABLE=y
CONFIG_BT_HFP_CLIENT_ENABLE=n

# Настройки безопасности
CONFIG_BT_SSP_ENABLED=y

# Буферы и таймауты
CONFIG_BT_BTC_TASK_STACK_SIZE=3072
CONFIG_BT_BTU_TASK_STACK_SIZE=4096
CONFIG_BT_BLUEDROID_MEM_DEBUG=n

# HFP AG основные возможности
CONFIG_BT_HFP_AG_FEAT_3WAY=y
CONFIG_BT_HFP_AG_FEAT_ECNR=y
CONFIG_BT_HFP_AG_FEAT_VREC=y
CONFIG_BT_HFP_AG_FEAT_INBAND=y
CONFIG_BT_HFP_AG_FEAT_VTAG=y
CONFIG_BT_HFP_AG_FEAT_REJECT=y
CONFIG_BT_HFP_AG_FEAT_ECS=y
CONFIG_BT_HFP_AG_FEAT_ECC=y
CONFIG_BT_HFP_AG_FEAT_CODEC=y
```
